/*
          8x8 LED Matrix MAX7219 Scrolling Text Example
       Based on the following library:
       GitHub | riyas-org/max7219  https://github.com/riyas-org/max7219
*/
#include <MaxMatrix.h>
#include <avr/pgmspace.h>

PROGMEM const unsigned char EN_chars[] = {
    3, 8, B00000000, B00000000, B00000000, B00000000, B00000000, // space
    1, 8, B01011111, B00000000, B00000000, B00000000, B00000000, // !
    3, 8, B00000011, B00000000, B00000011, B00000000, B00000000, // "
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    4, 8, B00001000, B00000100, B00001000, B00000100, B00000000, // ~
};

// الفبای فارسی
PROGMEM const unsigned char FA_chars_single[] = {
    3, 8, B00000000, B00000000, B00000000, B00000000, B00000000, B00000000, B00000000, B00000000, // " "
    3, 8, B00000000, B00111111, B00000000, B00000000, B00000000, B00000000, B00000000, B00000000, // ا
    5, 8, B00000000, B00111000, B10100000, B00100000, B00111000, B00000000, B00000000, B00000000, // ب
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    5, 8, B11110000, B10000000, B10110000, B11010000, B00000000, B00000000, B00000000, B00000000,// "ی"
};

PROGMEM const unsigned char FA_chars_bind_to_forward[] = {
    3, 8, B00000000, B00000000, B00000000, B00000000, B00000000, B00000000, B00000000, B00000000, // " "
    3, 8, B00000000, B00111111, B00000000, B00000000, B00000000, B00000000, B00000000, B00000000, // ا
    3, 8, B10100000, B00100000, B00111000, B00000000, B00000000, B00000000, B00000000, B00000000, // ب
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    3, 8, B10100000, B10100000, B00111000, B00000000, B00000000, B00000000, B00000000, B00000000, // ی
};

PROGMEM const unsigned char FA_chars_bind_to_back[] = {
    3, 8, B00000000, B00000000, B00000000, B00000000, B00000000, B00000000, B00000000, B00000000, // " "
    3, 8 ,B00000000, B00111111, B00100000, B00000000, B00000000, B00000000, B00000000, B00000000, // ا
    5, 8 ,B00111000, B10100000, B00100000, B00111000, B00100000, B00000000, B00000000, B00000000, // ب
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    6, 8, B11110000, B10000000, B10110000, B11010000, B00010000, B00100000, B00000000, B00000000, // ی
};

PROGMEM const unsigned char FA_chars_bind_to_both[] = {
    3, 8, B00000000, B00000000, B00000000, B00000000, B00000000, B00000000, B00000000, B00000000, // " "
    3, 8 ,B00000000, B00111111, B00100000, B00000000, B00000000, B00000000, B00000000, B00000000, // ا
    4, 8 ,B10100000, B00100000, B00111000, B00100000, B00000000, B00000000, B00000000, B00000000, // ب
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    4, 8, B10100000, B10100000, B00111000, B00100000, B00000000, B00000000, B00000000, B00000000, // ی
};






const int DIN = 10;     //IN pin of MAX7219 module
const int CLK = 13;     // CLK pin of MAX7219 module
const int CS = 11;      // CS pin of MAX7219 module
const int maxInUse = 4; // number of 8*8 modules
const int refrehDelay = 150; // delay time between shifts

MaxMatrix m(DIN, CS, CLK, maxInUse);




char16_t text[100] = u"سلام دنیا      "; // Scrolling text






void setup(){
    m.init();          // module initialize
    m.setIntensity(1); // dot matix intensity 0-15
    Serial.begin(9600);
}

void loop(){
  
        printStringWithShift(text);
 
        if (Serial.available() > 0){
          clearScreenAndText();
          readSerialInput();
        }
        
}

void clearScreenAndText(){
    for (int i = 0; i < 100; i++)
    {
        text[i] = 0;
    }
    m.clear(); // این چرا تو حلقس؟  دیگه نیست
}

void readSerialInput(){
    int count = 0;
    while (Serial.available() > 0)
    {
        text[count] = Serial.read();
        
        Serial.print("read: ");
        Serial.println(text[count]);
        
        count++;
    }
}

// Display=the extracted characters with scrolling
void printCharWithShift(char16_t c){
    byte buffer[10];

    if (c < 32)
        return;
    c -= 32;
    memcpy_P(buffer, EN_chars + 7 * c, 7);
    m.writeSprite(32, 0, buffer);
    m.setColumn(32 + buffer[0], 0);
    for (int i = 0; i < buffer[0] + 1; i++){
        delay(refrehDelay);
        m.shiftLeft(false, false); 
    }
    
}

void printPersianCharWithShift(char16_t c , bool  bindToPrevios, bool bindToNext){
    // todo

    // find right char
    byte buffer[10];

    if(!bindToPrevios && !bindToNext){
        memcpy_P(buffer, FA_chars_single + 10 * getPersianIndex(c), 10);
//        Serial.println("!pre  ::  !next");
    }

    if(!bindToPrevios && bindToNext){
        memcpy_P(buffer, FA_chars_bind_to_forward + 10 * getPersianIndex(c), 10);
//        Serial.println("!pre  ::  next");
    }

    if(bindToPrevios && !bindToNext){
        memcpy_P(buffer, FA_chars_bind_to_back + 10 * getPersianIndex(c), 10);
//        Serial.println("pre  ::  !next");
    }

    if(bindToPrevios && bindToNext){
        memcpy_P(buffer, FA_chars_bind_to_both + 10 * getPersianIndex(c), 10);
//        Serial.println("pre  ::  next");
    }

//for(int i=0;i<7;i++){
//  Serial.print(buffer[i]);
//  Serial.println(",");
//}

    // render
    // todo shift to right
    for (int i = 0; i < buffer[0]; i++){
        delay(refrehDelay);
        m.shiftRight(false, true);
    }

    m.writeSprite(0, 0, buffer);
}

int getPersianIndex(char16_t c){

    switch (c){
        case u' ': return 0;
        case u'ا': return 1;
        case u'ب': return 2;
        case u'پ': return 3;
        case u'ت': return 4;
        case u'ث': return 5;
        case u'ج': return 6;
        case u'چ': return 7;
        case u'ح': return 8;
        case u'خ': return 9;
        case u'د': return 10;
        case u'ذ': return 11;
        case u'ر': return 12;
        case u'ز': return 13;
        case u'ژ': return 14;
        case u'س': return 15;
        case u'ش': return 16;
        case u'ص': return 17;
        case u'ض': return 18;
        case u'ط': return 19;
        case u'ظ': return 20;
        case u'ع': return 21;
        case u'غ': return 22;
        case u'ف': return 23;
        case u'ق': return 24;
        case u'ک': return 25;
        case u'گ': return 26;
        case u'ل': return 27;
        case u'م': return 28;
        case u'ن': return 29;
        case u'و': return 30;
        case u'ه': return 31;
        case u'ی': return 32;
        
        default : return 32;
    }
}

// چپطظگکمنتلبیسشجحخهعغفقثصض true
// ودذرزژا false
bool canMergeToForward(char16_t c){
    
    switch (c){

    case u'و': return false;
    case u'د': return false;
    case u'ذ': return false;
    case u'ر': return false;
    case u'ز': return false;
    case u'ژ': return false;
    case u'ا': return false;
    case u' ': return false;
    
    default: return true;

    }
}

// false for " " , true for others
bool canMergeToBack(char16_t c){
    
    if(c == ' ') return false;
    else return true;
}


// Extract the characters from the text string
void printStringWithShift(char16_t *s){

    // detect if text is persian
    // this will not support mixed persian and english text

    
    
    bool isFirstChar = true;

    if (*s >= 1000){// persian text

        Serial.println("persian");
        while (*s != 0){
//          Serial.println(*s);

              if(isFirstChar){// first char
                   printPersianCharWithShift(*s ,false  ,canMergeToBack( *(s+1) ));
                   isFirstChar = false;

                   
              }else if(*(s+1) == 0){// last char
                  printPersianCharWithShift(*s ,canMergeToForward(*(s-1))  ,false );


              }else{// other chars
                  printPersianCharWithShift(*s ,canMergeToForward(*(s-1))  ,canMergeToBack(*(s+1)));
              }
            s++;
        }
    } else{ // english text

        Serial.println("english");
        while (*s != 0){
          
            printCharWithShift(*s);
            s++;
        }
    }
}

